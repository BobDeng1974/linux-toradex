## sound/soc/mp/Kconfig
```kconfig
menu "Musica Pristina Audio Aupport"
	depends on OF && I2C

config SND_SOC_MP_CODEC
	tristate "Musica Pristina Codec Support"
	select SND_SOC_GENERIC_DMAENGINE_PCM
	select REGMAP_MMIO
	help
	  Select Y or M to add support for the Codec embedded in the Musica 
	  Pristina and affiliated SoCs.

config SND_SOC_MP_I2S
	tristate "Musica Pristina I2S Support"
	select SND_SOC_GENERIC_DMAENGINE_PCM
	select REGMAP_MMIO
	help
	  Say Y or M if you want to add support for codecs attached to
	  the Musica Pristina I2S. You will also need to select the
	  individual machine drivers to support below.
endmenu
```
